## drivers/hid/ithc/Kconfig
```kconfig
# SPDX-License-Identifier: GPL-2.0-or-later

config HID_ITHC
	tristate "Linux driver for Intel Touch Host Controller"
  depends on PCI
	depends on HID
	help
	  Say Y here if your system has a touchscreen using Intel
	  Touch Host Controller technology (Which is used on surfacePro 7+ and 8)

	  If unsure say N.

	  To compile this driver as a module, choose M here: the
	  module will be called ipts.
```

## fs/apfs/Kconfig
```kconfig
# SPDX-License-Identifier: GPL-2.0

config LZFSE
	tristate "lzfse de/compress"

config APFS_FS
	tristate "Apfs filesystem support"
	select CRYPTO
	select CRYPTO_CRC32C
	select LIBCRC32C
	select CRYPTO_XXHASH
	select CRYPTO_SHA256
	select CRYPTO_BLAKE2B
	select ZLIB_INFLATE
	select ZLIB_DEFLATE
	select LZO_COMPRESS
	select LZO_DECOMPRESS
	select ZSTD_COMPRESS
	select ZSTD_DECOMPRESS
	select LZFSE
	select FS_IOMAP
	select RAID6_PQ
	select XOR_BLOCKS
	select SRCU
	depends on !PPC_256K_PAGES	# powerpc
	depends on !PAGE_SIZE_256KB	# hexagon

	help
      Apple File System(APFS) is a successor filesystem of hfsplus
      and was introduced by Apple Inc. It is widely used in many apple devices.

	  The filesystem disk format is documented at
      https://developer.apple.com/support/downloads/Apple-File-System-Reference.pdf

      For now, the aim is to mount FS in readonly mode.

	  To compile this file system support as a module, choose M here. The
	  module will be called apfs.
      WARN: The implementation of APFS is written by my interests. It's
      dangerous, unstable and bugous. So use it at your risks.

	  If unsure, say N.

config APFS_FS_POSIX_ACL
	bool "Apfs POSIX Access Control Lists"
	depends on APFS_FS
	select FS_POSIX_ACL
	help
	  POSIX Access Control Lists (ACLs) support permissions for users and
	  groups beyond the owner/group/world scheme.

	  If you don't know what Access Control Lists are, say N

config APFS_FS_CHECK_INTEGRITY
	bool "Apfs with integrity check tool compiled in (DANGEROUS)"
	depends on APFS_FS
	help
	  Adds code that examines all block write requests (including
	  writes of the super block). The goal is to verify that the
	  state of the filesystem on disk is always consistent, i.e.,
	  after a power-loss or kernel panic event the filesystem is
	  in a consistent state.

	  If the integrity check tool is included and activated in
	  the mount options, plenty of kernel memory is used, and
	  plenty of additional CPU cycles are spent. Enabling this
	  functionality is not intended for normal use.

	  In most cases, unless you are a apfs developer who needs
	  to verify the integrity of (super)-block write requests
	  during the run of a regression test, say N

config APFS_FS_RUN_SANITY_TESTS
	bool "Apfs will run sanity tests upon loading"
	depends on APFS_FS
	help
	  This will run some basic sanity tests on the free space cache
	  code to make sure it is acting as it should.  These are mostly
	  regression tests and are only really interesting to apfs
	  developers.

	  If unsure, say N.

config APFS_DEBUG
	bool "Apfs debugging support"
	depends on APFS_FS
	help
	  Enable run-time debugging support for the apfs filesystem. This may
	  enable additional and expensive checks with negative impact on
	  performance, or export extra information via sysfs.

	  If unsure, say N.

config APFS_ASSERT
	bool "Apfs assert support"
	depends on APFS_FS
	help
	  Enable run-time assertion checking.  This will result in panics if
	  any of the assertions trip.  This is meant for apfs developers only.

	  If unsure, say N.

config APFS_FS_REF_VERIFY
	bool "Apfs with the ref verify tool compiled in"
	depends on APFS_FS
	default n
	help
	  Enable run-time extent reference verification instrumentation.  This
	  is meant to be used by apfs developers for tracking down extent
	  reference problems or verifying they didn't break something.

	  If unsure, say N.
```
